## Documentation/devicetree/bindings/media/i2c/maxim-serializer.yaml
```yaml
# SPDX-License-Identifier: GPL-2.0
# Copyright (C) 2023 Analog Devices Inc.
%YAML 1.2
---
$id: http://devicetree.org/schemas/media/i2c/maxim-serializer.yaml#
$schema: http://devicetree.org/meta-schemas/core.yaml#

title: Maxim GMSL2 Serializer

maintainers:
  - Cosmin Tanislav <cosmin.tanislav@analog.com>

allOf:
  - $ref: /schemas/pinctrl/i2c/i2c-atr.yaml#

unevaluatedProperties: false

required:
  - '#address-cells':
  - '#size-cells'
  - reg
  - i2c-atr
  - i2c-alias-pool

properties:
  '#address-cells':
    const: 1

  '#size-cells':
    const: 0

  reg:
    description: I2C device address
    maxItems: 1

  maxim,tunnel-mode:
    type: boolean
    description: |
      Whether to use tunnel mode.
      While in tunnel mode, the device forwards all received data to the
      deserializer.

  i2c-atr:
    type: object
    additionalProperties: false

    properties:
      '#address-cells':
        const: 1

      '#size-cells':
        const: 0

    patternProperties:
      '^i2c@[0-9a-f]+$':
        unevaluatedProperties: false

        allOf:
          - $ref: /schemas/i2c/i2c-controller.yaml

patternProperties:
  '^pipe@[0-9a-f]+$':
    type: object
    additionalProperties: false
    description: |
      A pipe can carry multiple video streams with each stream having
      different virtual channels and data types.

      A pipe operates in one of the following modes:
       - Mode 1: Streams with the same bpp of up to 24 bpp.
       - Mode 2: Streams with 16, 14, 12, 10, 8 bpp, with streams less than
                 16 bpp being zero-padded.
       - Mode 3: Streams with two different bpp rates, one being double
                 the other, with the highest possible bpp being 24.
      Only modes 1 and 3 carry data at full bandwidth.

      Each pipe receives data from a PHY, and multiple pipes can receive data
      from the same PHY.

    properties:
      reg:
        description: The pipe id.
        maxItems: 1
```

## drivers/staging/media/max96717/Kconfig
```kconfig
# SPDX-License-Identifier: GPL-2.0
config VIDEO_MAX96717
	tristate "Maxim MAX96712 GMSL2 Serializer support"
	depends on I2C
	depends on OF_GPIO
	depends on VIDEO_V4L2
	select V4L2_FWNODE
	select VIDEO_V4L2_SUBDEV_API
	select MEDIA_CONTROLLER
	help
	  This driver supports the Maxim MAX96717 GMSL2 Seserializer.

	  To compile this driver as a module, choose M here: the
	  module will be called max96717.
```
