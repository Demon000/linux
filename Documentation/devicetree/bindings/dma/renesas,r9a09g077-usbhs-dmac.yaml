## Documentation/devicetree/bindings/dma/renesas,r9a09g077-usbhs-dmac.yaml
```yaml
# SPDX-License-Identifier: (GPL-2.0-only OR BSD-2-Clause)
%YAML 1.2
---
$id: http://devicetree.org/schemas/dma/renesas,r9a09g077-usbhs-dmac.yaml#
$schema: http://devicetree.org/meta-schemas/core.yaml#

title: Renesas RZ/T2H USB DMA Controller

description:
  The USB DMA Controller is embedded in the USB 2.0 High-Speed Function
  Module (USBf) and performs data transfers between memory and the USB
  FIFOs. It has two channels, each fixed to a specific USB FIFO.

maintainers:
  - Cosmin Tanislav <cosmin-gabriel.tanislav.xa@renesas.com>

allOf:
  - $ref: dma-controller.yaml#

properties:
  compatible:
    oneOf:
      - const: renesas,r9a09g077-usbhs-dmac # RZ/T2H

      - items:
          - const: renesas,r9a09g087-usbhs-dmac # RZ/N2H
          - const: renesas,r9a09g077-usbhs-dmac # RZ/T2H

  reg:
    maxItems: 1

  interrupts:
    maxItems: 2

  interrupt-names:
    items:
      - const: ch0
      - const: ch1

  clocks:
    maxItems: 1

  '#dma-cells':
    const: 1
    description:
      The cell specifies the channel number of the DMAC port connected to
      the DMA client.

  dma-channels:
    const: 2

  power-domains:
    maxItems: 1

required:
  - compatible
  - reg
  - interrupts
  - interrupt-names
  - clocks
  - '#dma-cells'
  - dma-channels
  - power-domains

additionalProperties: false

examples:
  - |
    #include <dt-bindings/clock/renesas,r9a09g077-cpg-mssr.h>
    #include <dt-bindings/interrupt-controller/arm-gic.h>

    dma-controller@92041400 {
        compatible = "renesas,r9a09g077-usbhs-dmac";
        reg = <0x92041400 0x330>;
        interrupts = <GIC_SPI 588 IRQ_TYPE_LEVEL_HIGH>,
                     <GIC_SPI 589 IRQ_TYPE_LEVEL_HIGH>;
        interrupt-names = "ch0", "ch1";
        clocks = <&cpg CPG_MOD 408>;
        power-domains = <&cpg>;
        #dma-cells = <1>;
        dma-channels = <2>;
    };
```

## Documentation/devicetree/bindings/media/i2c/maxim,max9296a.yaml
```yaml
# SPDX-License-Identifier: GPL-2.0
# Copyright (C) 2025 Analog Devices Inc.
%YAML 1.2
---
$id: http://devicetree.org/schemas/media/i2c/maxim,max9296a.yaml#
$schema: http://devicetree.org/meta-schemas/core.yaml#

title: Maxim MAX9296A/MAX96714/F/R/MAX96716/MAX96792A GMSL Deserializers

maintainers:
  - Cosmin Tanislav <cosmin.tanislav@analog.com>

description: |
  The MAX9296A is a deserializer that receives two GMSL2 links and outputs
  video data to 1 or 2 MIPI D-PHY outputs.
  The MAX96714 is a variant of the MAX9296A that only receives one link.
  The MAX96716A is a variant of the MAX96714 that receives two links.
  The MAX96792A is a GMSL3-compatible variant of the MAX96714.

unevaluatedProperties: false

properties:
  compatible:
    oneOf:
      - const: maxim,max9296a
      - const: maxim,max96714
      - const: maxim,max96714f
      - const: maxim,max96714r
      - const: maxim,max96716a
      - const: maxim,max96792a

  '#address-cells':
    const: 1

  '#size-cells':
    const: 0

  reg:
    maxItems: 1

  powerdown-gpios:
    maxItems: 1
    description:
      Specifier for the GPIO connected to the PWDNB pin.

allOf:
  - if:
      properties:
        compatible:
          contains:
            enum:
              - maxim,max96714
              - maxim,max96714f
              - maxim,max96714r
    then:
      properties:
        i2c-gate:
          $ref: /schemas/i2c/i2c-gate.yaml
          unevaluatedProperties: false

  - if:
      properties:
        compatible:
          contains:
            enum:
              - maxim,max9296a
              - maxim,max96792a
    then:
      properties:
        i2c-alias-pool:
          maxItems: 2

        i2c-atr:
          patternProperties:
            '^i2c@[0-1]$':
              $ref: /schemas/i2c/i2c-controller.yaml#
              properties:
                reg:
                  items:
                    min: 0
                    max: 1

  - if:
      properties:
        compatible:
          contains:
            const: maxim,max96716a
    then:
      properties:
        unevaluatedProperties: false
        i2c-mux:
          $ref: /schemas/i2c/i2c-mux.yaml#
          patternProperties:
            '^i2c@[0-1]$':
              $ref: /schemas/i2c/i2c-controller.yaml#
              properties:
                reg:
                  items:
                    min: 0
                    max: 1

required:
  - '#address-cells':
  - '#size-cells'
  - compatible
  - reg

allOf:
  - $ref: /schemas/i2c/i2c-atr.yaml#
  - oneOf:
    - required:
        - i2c-atr
        - i2c-alias-pool
    - required:
        - i2c-mux
    - required:
        - i2c-gate
```

## Documentation/devicetree/bindings/media/i2c/maxim,max96717.yaml
```yaml
# SPDX-License-Identifier: GPL-2.0
# Copyright (C) 2025 Analog Devices Inc.
%YAML 1.2
---
$id: http://devicetree.org/schemas/media/i2c/maxim,max96717.yaml#
$schema: http://devicetree.org/meta-schemas/core.yaml#

title: Maxim MAX96717/MAX9295A/MAX96793 GMSL Serializers

maintainers:
  - Cosmin Tanislav <cosmin.tanislav@analog.com>

description: |
  The MAX96717 and MAX9295A are serializers that receive video on an
  MIPI CSI-2 interface and outputs it on a GMSL2 link.
  The MAX96793 is a GMSL3-compatible variant of the MAX96717.

unevaluatedProperties: false

properties:
  compatible:
    items:
      - enum:
          - maxim,max9295a
          - maxim,max96717
          - maxim,max96793

  gpio-controller: true

  '#gpio-cells':
    const: 2

  i2c-alias-pool:
    maxItems: 2

  i2c-atr:
    patternProperties:
      '^i2c@0':
        $ref: /schemas/i2c/i2c-controller.yaml#
        properties:
          reg:
            items:
              max: 0

  i2c-gate:
    $ref: /schemas/i2c/i2c-gate.yaml
    unevaluatedProperties: false

required:
  - compatible
  - gpio-controller
  - '#gpio-cells'

additionalProperties:
  anyOf:
    - type: object
      allOf:
        - $ref: /schemas/media/i2c/maxim,max96717-pinctrl.yaml#

      unevaluatedProperties: false

    - type: object
      additionalProperties:
        type: object
        allOf:
          - $ref: /schemas/media/i2c/maxim,max96717-pinctrl.yaml#

        unevaluatedProperties: false

allOf:
  - $ref: /schemas/i2c/i2c-atr.yaml#
  - oneOf:
    - required:
        - i2c-atr
        - i2c-alias-pool
    - required:
        - i2c-gate
```

## Documentation/devicetree/bindings/media/i2c/maxim,max96724.yaml
```yaml
# SPDX-License-Identifier: GPL-2.0
# Copyright (C) 2025 Analog Devices Inc.
%YAML 1.2
---
$id: http://devicetree.org/schemas/media/i2c/maxim,max96724.yaml#
$schema: http://devicetree.org/meta-schemas/core.yaml#

title: Maxim MAX96712/MAX96724 GMSL2 Deserializers

maintainers:
  - Cosmin Tanislav <cosmin.tanislav@analog.com>

description: |
  The MAX96712/MAX96724 are deserializers that receive four GMSL2 links
  and output video data to 1, 2, or 4 MIPI D-PHY or C-PHY outputs.

unevaluatedProperties: false

properties:
  compatible:
    items:
      - enum:
          - maxim,max96712
          - maxim,max96724

  '#address-cells':
    const: 1

  '#size-cells':
    const: 0

  reg:
    maxItems: 1

  i2c-mux:
    $ref: /schemas/i2c/i2c-mux.yaml#
    patternProperties:
      '^i2c@[0-3]$':
        $ref: /schemas/i2c/i2c-controller.yaml#
        properties:
          reg:
            items:
              min: 0
              max: 3

required:
  - '#address-cells':
  - '#size-cells'
  - compatible
  - reg
```

## Documentation/devicetree/bindings/media/i2c/maxim-deserializer.yaml
```yaml
# SPDX-License-Identifier: GPL-2.0
# Copyright (C) 2023 Analog Devices Inc.
%YAML 1.2
---
$id: http://devicetree.org/schemas/media/i2c/maxim-deserializer.yaml#
$schema: http://devicetree.org/meta-schemas/core.yaml#

title: Maxim GMSL2 Deserializer

maintainers:
  - Cosmin Tanislav <cosmin.tanislav@analog.com>

allOf:
  - $ref: /schemas/pinctrl/i2c/i2c-atr.yaml#

unevaluatedProperties: false

required:
  - '#address-cells':
  - '#size-cells'
  - reg
  - i2c-atr
  - i2c-alias-pool

properties:
  '#address-cells':
    const: 1

  '#size-cells':
    const: 0

  reg:
    description: I2C device address
    maxItems: 1

  i2c-atr:
    type: object
    additionalProperties: false

    patternProperties:
      '^i2c@[0-9a-f]+$':
        unevaluatedProperties: false

        allOf:
          - $ref: /schemas/i2c/i2c-controller.yaml
```
