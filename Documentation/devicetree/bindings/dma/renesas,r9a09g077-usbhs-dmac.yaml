## Documentation/devicetree/bindings/pwm/renesas,r9a09g077-gpt.yaml
```yaml
# SPDX-License-Identifier: (GPL-2.0-only OR BSD-2-Clause)
%YAML 1.2
---
$id: http://devicetree.org/schemas/pwm/renesas,r9a09g077-gpt.yaml#
$schema: http://devicetree.org/meta-schemas/core.yaml#

title: Renesas RZ/T2H and RZ/N2H General PWM Timer (GPT)

maintainers:
  - Cosmin Tanislav <cosmin-gabriel.tanislav.xa@renesas.com>

description: |
  The RZ/T2H and RZ/N2H feature multiple General PWM Timer (GPT) units
  composed of 4, 5 or 7 channels with 32-bit timers. Each channel supports
  the following functions
  * Up-counting or down-counting (saw waves) or up/down-counting
    (triangle waves).
  * Clock sources independently selectable for each channel.
  * Two I/O pins per channel.
  * Two output compare/input capture registers per channel.
  * For the two output compare/input capture registers of each channel,
    four registers are provided as buffer registers and are capable of
    operating as comparison registers when buffering is not in use.
  * Registers for setting up frame cycles in each channel (with capability
    for generating interrupts at overflow or underflow).
  * Generation of dead times in PWM operation.
  * Synchronous starting, stopping and clearing counters for arbitrary
    channels.
  * Phase counting from a quadrature or pulse signal pair.
  * Enables the noise filter for input capture and external trigger
    operation.

  Each channel exposes five interrupt lines routed through the Interrupt
  Control Unit (ICU). Four of them (int0 to int3) each carry a single
  channel event source selected in the ICU, while the fifth (int4) is the
  combination of all event sources of the channel, individually maskable
  in the ICU.

  Two PWM channels are provided per timer channel, one for each I/O pin.

properties:
  compatible:
    oneOf:
      - const: renesas,r9a09g077-gpt # RZ/T2H

      - items:
          - const: renesas,r9a09g087-gpt # RZ/N2H
          - const: renesas,r9a09g077-gpt # RZ/T2H

  reg:
    maxItems: 1

  '#pwm-cells':
    const: 3

  interrupts:
    minItems: 20
    maxItems: 35
    items:
      - description: Channel 0 selected interrupt 0
      - description: Channel 0 selected interrupt 1
      - description: Channel 0 selected interrupt 2
      - description: Channel 0 selected interrupt 3
      - description: Channel 0 combined interrupt
      - description: Channel 1 selected interrupt 0
      - description: Channel 1 selected interrupt 1
      - description: Channel 1 selected interrupt 2
      - description: Channel 1 selected interrupt 3
      - description: Channel 1 combined interrupt
      - description: Channel 2 selected interrupt 0
      - description: Channel 2 selected interrupt 1
      - description: Channel 2 selected interrupt 2
      - description: Channel 2 selected interrupt 3
      - description: Channel 2 combined interrupt
      - description: Channel 3 selected interrupt 0
      - description: Channel 3 selected interrupt 1
      - description: Channel 3 selected interrupt 2
      - description: Channel 3 selected interrupt 3
      - description: Channel 3 combined interrupt
      - description: Channel 4 selected interrupt 0
      - description: Channel 4 selected interrupt 1
      - description: Channel 4 selected interrupt 2
      - description: Channel 4 selected interrupt 3
      - description: Channel 4 combined interrupt
      - description: Channel 5 selected interrupt 0
      - description: Channel 5 selected interrupt 1
      - description: Channel 5 selected interrupt 2
      - description: Channel 5 selected interrupt 3
      - description: Channel 5 combined interrupt
      - description: Channel 6 selected interrupt 0
      - description: Channel 6 selected interrupt 1
      - description: Channel 6 selected interrupt 2
      - description: Channel 6 selected interrupt 3
      - description: Channel 6 combined interrupt

  interrupt-names:
    minItems: 20
    maxItems: 35
    items:
      - const: ch0_int0
      - const: ch0_int1
      - const: ch0_int2
      - const: ch0_int3
      - const: ch0_int4
      - const: ch1_int0
      - const: ch1_int1
      - const: ch1_int2
      - const: ch1_int3
      - const: ch1_int4
      - const: ch2_int0
      - const: ch2_int1
      - const: ch2_int2
      - const: ch2_int3
      - const: ch2_int4
      - const: ch3_int0
      - const: ch3_int1
      - const: ch3_int2
      - const: ch3_int3
      - const: ch3_int4
      - const: ch4_int0
      - const: ch4_int1
      - const: ch4_int2
      - const: ch4_int3
      - const: ch4_int4
      - const: ch5_int0
      - const: ch5_int1
      - const: ch5_int2
      - const: ch5_int3
      - const: ch5_int4
      - const: ch6_int0
      - const: ch6_int1
      - const: ch6_int2
      - const: ch6_int3
      - const: ch6_int4

  clocks:
    items:
      - description: Core clock
      - description: Bus clock

  clock-names:
    items:
      - const: core
      - const: bus

  power-domains:
    maxItems: 1

  renesas,num-channels:
    description: Number of channels of the GPT unit.
    $ref: /schemas/types.yaml#/definitions/uint32
    enum: [ 4, 5, 7 ]

required:
  - compatible
  - reg
  - interrupts
  - interrupt-names
  - clocks
  - clock-names
  - power-domains
  - renesas,num-channels
  - '#pwm-cells'

allOf:
  - $ref: pwm.yaml#

additionalProperties: false

examples:
  - |
    #include <dt-bindings/clock/renesas-cpg-mssr.h>
    #include <dt-bindings/clock/renesas,r9a09g077-cpg-mssr.h>
    #include <dt-bindings/interrupt-controller/arm-gic.h>

    gpt0: pwm@90002000 {
        compatible = "renesas,r9a09g077-gpt";
        reg = <0x90002000 0x500>;
        interrupts = <GIC_SPI 97 IRQ_TYPE_EDGE_RISING>,
                     <GIC_SPI 98 IRQ_TYPE_EDGE_RISING>,
                     <GIC_SPI 99 IRQ_TYPE_EDGE_RISING>,
                     <GIC_SPI 100 IRQ_TYPE_EDGE_RISING>,
                     <GIC_SPI 101 IRQ_TYPE_EDGE_RISING>,
                     <GIC_SPI 102 IRQ_TYPE_EDGE_RISING>,
                     <GIC_SPI 103 IRQ_TYPE_EDGE_RISING>,
                     <GIC_SPI 104 IRQ_TYPE_EDGE_RISING>,
                     <GIC_SPI 105 IRQ_TYPE_EDGE_RISING>,
                     <GIC_SPI 106 IRQ_TYPE_EDGE_RISING>,
                     <GIC_SPI 107 IRQ_TYPE_EDGE_RISING>,
                     <GIC_SPI 108 IRQ_TYPE_EDGE_RISING>,
                     <GIC_SPI 109 IRQ_TYPE_EDGE_RISING>,
                     <GIC_SPI 110 IRQ_TYPE_EDGE_RISING>,
                     <GIC_SPI 111 IRQ_TYPE_EDGE_RISING>,
                     <GIC_SPI 112 IRQ_TYPE_EDGE_RISING>,
                     <GIC_SPI 113 IRQ_TYPE_EDGE_RISING>,
                     <GIC_SPI 114 IRQ_TYPE_EDGE_RISING>,
                     <GIC_SPI 115 IRQ_TYPE_EDGE_RISING>,
                     <GIC_SPI 116 IRQ_TYPE_EDGE_RISING>,
                     <GIC_SPI 117 IRQ_TYPE_EDGE_RISING>,
                     <GIC_SPI 118 IRQ_TYPE_EDGE_RISING>,
                     <GIC_SPI 119 IRQ_TYPE_EDGE_RISING>,
                     <GIC_SPI 120 IRQ_TYPE_EDGE_RISING>,
                     <GIC_SPI 121 IRQ_TYPE_EDGE_RISING>;
        interrupt-names = "ch0_int0", "ch0_int1", "ch0_int2",
                          "ch0_int3", "ch0_int4",
                          "ch1_int0", "ch1_int1", "ch1_int2",
                          "ch1_int3", "ch1_int4",
                          "ch2_int0", "ch2_int1", "ch2_int2",
                          "ch2_int3", "ch2_int4",
                          "ch3_int0", "ch3_int1", "ch3_int2",
                          "ch3_int3", "ch3_int4",
                          "ch4_int0", "ch4_int1", "ch4_int2",
                          "ch4_int3", "ch4_int4";
        clocks = <&cpg CPG_MOD 201>,
                 <&cpg CPG_CORE R9A09G077_CLK_PCLKH>;
        clock-names = "core", "bus";
        power-domains = <&cpg>;
        renesas,num-channels = <5>;
        #pwm-cells = <3>;
    };
```
