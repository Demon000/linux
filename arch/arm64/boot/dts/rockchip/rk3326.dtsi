// SPDX-License-Identifier: (GPL-2.0+ OR MIT)
/*
 * Copyright (c) 2020 Fuzhou Rockchip Electronics Co., Ltd
 */

#include "px30.dtsi"

&display_subsystem {
	ports = <&vopb_out>;
};

&gpu_opp_table {
	opp-520000000 {
		opp-hz = /bits/ 64 <520000000>;
		opp-microvolt = <1150000>;
	};
};

/delete-node/ &dsi_in_vopl;
/delete-node/ &lvds_vopl_in;
/delete-node/ &vopl;
/delete-node/ &vopl_mmu;
