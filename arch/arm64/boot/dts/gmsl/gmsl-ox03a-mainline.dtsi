// SPDX-License-Identifier: GPL-2.0
/*
 * Copyright (C) 2023 Analog Devices Inc.
 */

#if defined(CAM_INDEX)
#define CAM_VC_ID		CAM_INDEX
#define CAM_SER_INDEX		CAM_INDEX
#define CAM_SER_LABEL		CONCAT(ser_, CAM_SER_INDEX)
#define CAM_PWDN_LABEL		CONCAT(CAM_SER_LABEL, _mfp0_pwdn)
#define CAM_RCLK_LABEL		CONCAT(CAM_SER_LABEL, _mfp4_rclk)
#define CAM_OUT_LABEL		CAM_X_OUT_LABEL(CAM_INDEX)
#define CAM_LABEL		CONCAT(cam_, CAM_INDEX)
#endif

#if defined(SER_INDEX) && defined(SER_CH_INDEX)
#define CAM_OUT_REMOTE_LABEL	SER_X_LINK_Y_IN_LABEL(SER_INDEX, SER_CH_INDEX)
#endif

#if !defined(CAM_HEX_REG)
#error
#endif

#if !defined(CAM_VC_ID)
#error
#endif

#if !defined(CAM_SER_LABEL)
#error
#endif

#if !defined(CAM_PWDN_LABEL)
#error
#endif

#if !defined(CAM_RCLK_LABEL)
#error
#endif

#if !defined(CAM_OUT_LABEL)
#error
#endif

#if !defined(CAM_OUT_REMOTE_LABEL)
#error
#endif

#if !defined(CAM_LABEL)
#error
#endif

CAM_LABEL: ox03a@CAM_HEX_REG {
	#address-cells = <1>;
	#size-cells = <0>;

	compatible = "ov,ox03a";
	reg = <CAM_HEX_REG>;

	clocks = <&cam24m>;
	clock-names = "xclk";

	pinctrl-0 = <&CAM_PWDN_LABEL &CAM_RCLK_LABEL>;
	pinctrl-names = "default";

	reset-gpios = <&CAM_SER_LABEL 0 GPIO_ACTIVE_LOW>;

	ports {
		#address-cells = <1>;
		#size-cells = <0>;
		port@0 {
			reg = <0>;

			CAM_OUT_LABEL: endpoint {
				remote-endpoint = <&CAM_OUT_REMOTE_LABEL>;
				data-lanes = <1 2 3 4>;
				clock-lanes = <0>;
			};
		};
	};
};

#undef CAM_HEX_REG
#undef CAM_INDEX
#undef CAM_SER_INDEX
#undef CAM_SER_LABEL
#undef CAM_VC_ID
#undef CAM_PWDN_LABEL
#undef CAM_RCLK_LABEL
#undef CAM_LABEL
#undef CAM_OUT_LABEL
#undef CAM_OUT_REMOTE_LABEL
